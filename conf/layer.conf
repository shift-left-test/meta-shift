## conf/layer.conf
```bitbake
# We have a conf and classes directory, add to BBPATH
BBPATH .= ":${LAYERDIR}"

# We have recipes-* directories, add to BBFILES
BBFILES += "${LAYERDIR}/recipes-*/*/*.bb \
            ${LAYERDIR}/recipes-*/*/*.bbappend"

BBFILES_DYNAMIC += " \
    clang-layer:${LAYERDIR}/dynamic-layers/meta-clang/recipes-*/*/*.bb \
    clang-layer:${LAYERDIR}/dynamic-layers/meta-clang/recipes-*/*/*.bbappend \
    clang-layer:${LAYERDIR}/dynamic-layers/meta/recipes-*/*/*.bb \
    clang-layer:${LAYERDIR}/dynamic-layers/meta/recipes-*/*/*.bbappend \
"

BBFILE_COLLECTIONS += "meta-shift"
BBFILE_PATTERN_meta-shift = "^${LAYERDIR}/"
BBFILE_PRIORITY_meta-shift = "17"

LAYERDEPENDS_meta-shift = "core openembedded-layer meta-python"
LAYERSERIES_COMPAT_meta-shift = "styhead"

INHERIT += "shifttasks"

# Let tests suppress failures
SHIFT_TEST_SUPPRESS_FAILURES ??= "0"

# Let tests run in random order
SHIFT_TEST_SHUFFLE ??= "0"

# Stop running remaining tests at the first failure (CMake/Enact only).
SHIFT_TEST_STOP_ON_FAILURE ??= "0"

# Parallel test jobs for 'ctest --parallel' (CMake only); empty = serial.
# Use a number or "${@oe.utils.cpu_count()}" for all host cores.
SHIFT_TEST_PARALLEL_JOBS ??= ""

# Extra env vars to forward into the qemu-emulated test process via QEMU_SET_ENV
# (space-separated VAR=VALUE list, e.g. "LD_PRELOAD=${B}/tests/libfoo.so") so an
# LD_PRELOAD interposer reaches the guest instead of the host loader. CMake only.
SHIFT_TEST_QEMU_SET_ENV ??= ""

# Default value for the number of maximum mutants (0 means unlimited)
SHIFT_CHECKTEST_LIMIT ??= "0"

# Default mutation generator
# Currently supported generators are: random, uniform, weighted
SHIFT_CHECKTEST_GENERATOR ??= "uniform"

# Enable verbose sentinel output while running the do_checktest task (1 = verbose, 0 = quiet)
SHIFT_CHECKTEST_VERBOSE ??= "0"

# Mutation operators to apply (space-separated, repeatable)
SHIFT_CHECKTEST_OPERATORS ??= ""

# Glob patterns to constrain mutation scope (space-separated, '!' prefix for exclusion)
SHIFT_CHECKTEST_PATTERNS ??= ""

# Per-test timeout in seconds (default: sentinel auto = 1.5x baseline)
SHIFT_CHECKTEST_TIMEOUT ??= ""

# Diff base revision for scoping mutants (e.g., HEAD~5)
SHIFT_CHECKTEST_FROM ??= ""

# Include uncommitted changes in mutation scope
SHIFT_CHECKTEST_UNCOMMITTED ??= "0"

SHIFT_CHECKTEST_EXTENSIONS ??= ""

# Random seed for the mutation generator
SHIFT_CHECKTEST_SEED ??= ""

# exclude file or path for coverage (relative path starting from the source directory)
SHIFT_COVERAGE_EXCLUDES ??= ""

# Report branch coverage instead of line coverage in the text report
# (HTML and Cobertura always include both). 1 = branch, 0 = line.
SHIFT_COVERAGE_BRANCH ??= "0"

# Extra options passed verbatim to gcovr (e.g., --gcov-ignore-errors all)
SHIFT_COVERAGE_EXTRA_OPTIONS ??= ""

# Do not synchronize the tasks by default
SHIFT_PARALLEL_TASKS ??= "1"
```

## test/meta-temp/conf/layer.conf
```bitbake
BBPATH .= ":${LAYERDIR}"

BBFILES += "${LAYERDIR}/recipes/*/*.bb \
            ${LAYERDIR}/recipes/*/*.bbappend"

BBFILE_COLLECTIONS += "meta-temp"
BBFILE_PATTERN_meta-temp = "^${LAYERDIR}/"
BBFILE_PRIORITY_meta-temp = "18"

LAYERDEPENDS_meta-temp = "core meta-testing"
LAYERSERIES_COMPAT_meta-temp = "morty pyro rocko sumo thud warrior zeus"
```

## test/meta-test/conf/layer.conf
```bitbake
BBPATH =. "${LAYERDIR}:"

BBFILES += "${LAYERDIR}/recipes/*/*.bb \
            ${LAYERDIR}/recipes/*/*.bbappend"

BBFILE_COLLECTIONS += "meta-test"
BBFILE_PATTERN_meta-test = "^${LAYERDIR}/"
BBFILE_PRIORITY_meta-test = "99"

LAYERDEPENDS_meta-test = "core"
LAYERSERIES_COMPAT_meta-test = "sumo thud warrior zeus"
```
